// SPDX-License-Identifier: (GPL-2.0+ OR MIT)
/*
 * Copyright 2019 NXP
 */

#include "fsl-imx8mm-demo.dts"

&hdmi_bridge {
	status = "okay";
};

&display_timings {
	native-mode = <&timing0>;		/* 1080p */
};

&panel_ek79007 {
	status = "disabled";
};

&panel_hdmi {
	status = "okay";
};
