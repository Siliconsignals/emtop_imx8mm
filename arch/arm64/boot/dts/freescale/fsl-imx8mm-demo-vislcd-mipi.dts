// SPDX-License-Identifier: (GPL-2.0+ OR MIT)
/*
 * Copyright 2019 NXP
 */

#include "fsl-imx8mm-demo.dts"

&panel_ek79007 {
	status = "disabled";
};

&panel_vislcd_101hysx31p {
	reg = <0>;
	status = "okay";
};
